## conf/distro/ovc-mini.conf
```bitbake
require conf/distro/include/karo-distro.inc

DISTRO = "ovc-mini"
DISTRO_NAME = "ovc-mini (Ka-Ro Linux BSP with OVC flavoring)"
DISTRO_VERSION = "5.10-${DISTRO_CODENAME}"

DISTRO_FEATURES_append = " \
    iwlwifi \
"

MACHINE_FIRMWARE_append = "\
    linux-firmware-iwlwifi \
"

DISTRO_FEATURES_append = " wifi intel-wifi"
```

## conf/layer.conf
```bitbake
# We have a conf and classes directory, add to BBPATH
BBPATH .= ":${LAYERDIR}"

# We have a packages directory, add to BBFILES
BBFILES += "${LAYERDIR}/recipes-*/*/*.bb \
            ${LAYERDIR}/recipes-*/*/*.bbappend \
            ${LAYERDIR}/recipes-*/*.bb \
            ${LAYERDIR}/recipes-*/*.bbappend \
            ${LAYERDIR}/recipes-*/*/*/*.bb \
            ${LAYERDIR}/recipes-*/*/*/*.bbappend \
"

BBFILE_COLLECTIONS += "ovc-distro"
BBFILE_PATTERN_ovc-distro := "^${LAYERDIR}/"
BBFILE_PRIORITY_ovc-distro = "10"

LAYERDEPENDS_ovc-distro = "karo-distro"
LAYERSERIES_COMPAT_ovc-distro = "hardknott"

FILESYSTEM_PERMS_TABLES = "meta/files/fs-perms.txt"
```

## conf/machine/qsxm-mm60.conf
```bitbake
#@TYPE: Machine
#@NAME: Ka-Ro electronics NXP i.MX8MM QSXM-MM60 Computer-On-Module
#@SOC: i.MX8MM
#@DESCRIPTION: Machine configuration for Ka-Ro electronics QSXM-MM60 Computer-On-Module
#@MAINTAINER: Ka-Ro electronics GmbH <support@karo-electronics.com>
#@VERSION: 1
#@DATE: 2020-01-20

require conf/machine/qsxm-mm60.conf

# Set U-Boot DTB
#UBOOT_DTB_NAME = "imx8mm-qsxm-mm60-qsbase3-ovc.dtb"

# Ka-Ro specific Device Tree files to be compiled
KERNEL_DEVICETREE = " \
        freescale/imx8mm-qsxm-mm60-qsbase3-ovc.dtb \
"
```

## conf/machine/qsxp-ml81-ovc.conf
```bitbake
#@TYPE: Machine
#@NAME: Ka-Ro electronics NXP i.MX8MP QSXP-ML81 Computer-On-Module
#@SOC: i.MX8MP
#@DESCRIPTION: Machine configuration for Ka-Ro electronics QSXP-ML81 Computer-On-Module
#@MAINTAINER: Ka-Ro electronics GmbH <support@karo-electronics.com>
#@VERSION: 1
#@DATE: 2020-08-10

require conf/machine/qsxp-ml81.conf

# Set U-Boot DTB
#UBOOT_DTB_NAME = "imx8mp-qsxp-ml81-qsbase3-ovc.dtb"

# Ka-Ro specific Device Tree files to be compiled
KERNEL_DEVICETREE_append = " \
        freescale/imx8mp-qsxp-ml81-qsbase3-ovc.dtb \
"
```
